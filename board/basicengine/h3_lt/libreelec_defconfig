## configs/basicengine_h3_defconfig
```kconfig
BR2_arm=y
BR2_cortex_a7=y
BR2_ARM_FPU_NEON_VFPV4=y
BR2_PACKAGE_HOST_LINUX_HEADERS_CUSTOM_5_10=y
BR2_TOOLCHAIN_BUILDROOT_CXX=y
BR2_CCACHE=y
BR2_GLOBAL_PATCH_DIR="board/basicengine/h3/patches_jh"
BR2_TARGET_GENERIC_HOSTNAME="OrangePi_Lite"
BR2_TARGET_GENERIC_ISSUE="Welcome to Buildroot for the Orange Pi Lite"
BR2_ROOTFS_DEVICE_CREATION_DYNAMIC_EUDEV=y
BR2_GENERATE_LOCALE="en_US"
BR2_ROOTFS_OVERLAY="board/basicengine/common/rootfs_overlay"
BR2_ROOTFS_POST_IMAGE_SCRIPT="support/scripts/genimage.sh"
BR2_ROOTFS_POST_SCRIPT_ARGS="-c board/basicengine/h3/genimage.cfg"
BR2_LINUX_KERNEL=y
BR2_LINUX_KERNEL_CUSTOM_TARBALL=y
BR2_LINUX_KERNEL_CUSTOM_TARBALL_LOCATION="https://github.com/siemens/linux/archive/eb6927f7eea77f823b96c0c22ad9d4a2d7ffdfce.tar.gz"
BR2_LINUX_KERNEL_USE_CUSTOM_CONFIG=y
BR2_LINUX_KERNEL_CUSTOM_CONFIG_FILE="board/basicengine/h3/armhf_defconfig_5.10"
BR2_LINUX_KERNEL_DTS_SUPPORT=y
BR2_LINUX_KERNEL_INTREE_DTS_NAME="sun8i-h3-orangepi-lite sun8i-h3-bananapi-m2-plus sun8i-h3-bananapi-m2-plus-v1.2 sun8i-h3-beelink-x2 sun8i-h3-emlid-neutis-n5h3-devboard sun8i-h3-libretech-all-h3-cc sun8i-h3-mapleboard-mp130 sun8i-h3-nanopi-duo2 sun8i-h3-nanopi-m1 sun8i-h3-nanopi-m1-plus sun8i-h3-nanopi-neo-air sun8i-h3-nanopi-neo sun8i-h3-orangepi-2 sun8i-h3-orangepi-one sun8i-h3-orangepi-pc sun8i-h3-orangepi-pc-plus sun8i-h3-orangepi-plus2e sun8i-h3-orangepi-plus sun8i-h3-orangepi-zero-plus2 sun8i-h3-rervision-dvk sun8i-h2-plus-orangepi-r1 sun8i-h2-plus-orangepi-zero sun7i-a20-orangepi sun7i-a20-orangepi-mini"
BR2_LINUX_KERNEL_CUSTOM_DTS_PATH="board/basicengine/h3/sun8i-h3-r69-rtl8723as.dts"
BR2_LINUX_KERNEL_DTB_OVERLAY_SUPPORT=y
BR2_LINUX_KERNEL_NEEDS_HOST_OPENSSL=y
BR2_PACKAGE_BUSYBOX_CONFIG_FRAGMENT_FILES="board/basicengine/common/busybox-extras.config"
BR2_PACKAGE_ALSA_UTILS=y
BR2_PACKAGE_ALSA_UTILS_AMIXER=y
BR2_PACKAGE_LZOP=y
BR2_PACKAGE_ZSTD=y
BR2_PACKAGE_GDB=y
BR2_PACKAGE_GDB_DEBUGGER=y
BR2_PACKAGE_LTRACE=y
BR2_PACKAGE_STRACE=y
BR2_PACKAGE_DOSFSTOOLS=y
BR2_PACKAGE_DOSFSTOOLS_FSCK_FAT=y
BR2_PACKAGE_DOSFSTOOLS_MKFS_FAT=y
BR2_PACKAGE_E2FSPROGS=y
BR2_PACKAGE_SSHFS=y
BR2_PACKAGE_FROTZ=y
BR2_PACKAGE_SDL2=y
BR2_PACKAGE_CEDAR=y
BR2_PACKAGE_DTBOCFG=y
BR2_PACKAGE_KBD=y
BR2_PACKAGE_RTL8189ES=y
BR2_PACKAGE_RTL8189FS=y
BR2_PACKAGE_RTL8723AS=y
BR2_PACKAGE_RTL8723BU=y
BR2_PACKAGE_RTL8723DS=y
BR2_PACKAGE_RTL8723DS_BT=y
BR2_PACKAGE_USBMOUNT=y
BR2_PACKAGE_XR819_XRADIO=y
BR2_PACKAGE_ENGINEBASIC=y
BR2_PACKAGE_LUA=y
BR2_PACKAGE_DTC=y
BR2_PACKAGE_DTC_PROGRAMS=y
BR2_PACKAGE_LIBGUDEV=y
BR2_PACKAGE_LIBINPUT=y
BR2_PACKAGE_EXPAT=y
BR2_PACKAGE_LIBPTHREAD_STUBS=y
BR2_PACKAGE_NCURSES_ADDITIONAL_TERMINFO="a/ansiw c/cons25-debian"
BR2_PACKAGE_SLANG=y
BR2_PACKAGE_DROPBEAR=y
BR2_PACKAGE_DROPBEAR_DISABLE_REVERSEDNS=y
BR2_PACKAGE_NETCAT=y
BR2_PACKAGE_NETCAT_OPENBSD=y
# BR2_PACKAGE_OPENSSH_SERVER is not set
# BR2_PACKAGE_OPENSSH_KEY_UTILS is not set
BR2_PACKAGE_WIRELESS_TOOLS=y
BR2_PACKAGE_WPA_SUPPLICANT=y
BR2_PACKAGE_WPA_SUPPLICANT_WEXT=y
BR2_PACKAGE_WPA_SUPPLICANT_CLI=y
BR2_PACKAGE_WPA_SUPPLICANT_PASSPHRASE=y
BR2_PACKAGE_JAILHOUSE=y
BR2_PACKAGE_UTIL_LINUX_FDISKS=y
BR2_PACKAGE_UTIL_LINUX_LIBSMARTCOLS=y
BR2_PACKAGE_ATTO=y
BR2_PACKAGE_JOE=y
BR2_PACKAGE_LESS=y
BR2_PACKAGE_MC=y
BR2_PACKAGE_MG=y
BR2_PACKAGE_NANO=y
BR2_PACKAGE_UEMACS=y
BR2_PACKAGE_VIM=y
# BR2_PACKAGE_VIM_RUNTIME is not set
BR2_TARGET_ROOTFS_EXT2=y
BR2_TARGET_ROOTFS_EXT2_4=y
BR2_TARGET_ROOTFS_EXT2_SIZE="180M"
# BR2_TARGET_ROOTFS_TAR is not set
BR2_TARGET_UBOOT=y
BR2_TARGET_UBOOT_BUILD_SYSTEM_KCONFIG=y
BR2_TARGET_UBOOT_CUSTOM_VERSION=y
BR2_TARGET_UBOOT_CUSTOM_VERSION_VALUE="2021.10"
BR2_TARGET_UBOOT_BOARD_DEFCONFIG="orangepi_lite"
BR2_TARGET_UBOOT_CONFIG_FRAGMENT_FILES="board/basicengine/common/uboot-extras.config"
BR2_TARGET_UBOOT_NEEDS_DTC=y
BR2_TARGET_UBOOT_NEEDS_PYLIBFDT=y
BR2_TARGET_UBOOT_SPL=y
BR2_TARGET_UBOOT_SPL_NAME="u-boot-sunxi-with-spl.bin"
BR2_PACKAGE_HOST_DOSFSTOOLS=y
BR2_PACKAGE_HOST_GENIMAGE=y
BR2_PACKAGE_HOST_MTOOLS=y
BR2_PACKAGE_HOST_UBOOT_TOOLS=y
BR2_PACKAGE_HOST_UBOOT_TOOLS_BOOT_SCRIPT=y
BR2_PACKAGE_HOST_UBOOT_TOOLS_BOOT_SCRIPT_SOURCE="board/orangepi/orangepi-lite/boot.cmd"
```

## configs/basicengine_h3_lt_defconfig
```kconfig
BR2_arm=y
BR2_cortex_a7=y
BR2_ARM_FPU_NEON_VFPV4=y
BR2_TOOLCHAIN_BUILDROOT_CXX=y
BR2_CCACHE=y
BR2_GLOBAL_PATCH_DIR="board/basicengine/h3_lt/patches"
BR2_TARGET_GENERIC_HOSTNAME="basicengine"
BR2_TARGET_GENERIC_ISSUE="Welcome to Buildroot for the BASIC Engine H3"
BR2_ROOTFS_DEVICE_CREATION_DYNAMIC_EUDEV=y
BR2_ROOTFS_OVERLAY="board/basicengine/common/rootfs_overlay board/basicengine/lt/rootfs_overlay"
BR2_ROOTFS_POST_IMAGE_SCRIPT="support/scripts/genimage.sh"
BR2_ROOTFS_POST_SCRIPT_ARGS="-c board/basicengine/h3_lt/genimage.cfg"
BR2_LINUX_KERNEL=y
BR2_LINUX_KERNEL_CUSTOM_VERSION=y
BR2_LINUX_KERNEL_CUSTOM_VERSION_VALUE="6.6.21"
BR2_LINUX_KERNEL_USE_CUSTOM_CONFIG=y
BR2_LINUX_KERNEL_CUSTOM_CONFIG_FILE="board/basicengine/h3_lt/libreelec_defconfig"
BR2_LINUX_KERNEL_DTS_SUPPORT=y
BR2_LINUX_KERNEL_INTREE_DTS_NAME="allwinner/sun8i-h3-orangepi-lite allwinner/sun8i-h3-bananapi-m2-plus allwinner/sun8i-h3-bananapi-m2-plus-v1.2 allwinner/sun8i-h3-beelink-x2 allwinner/sun8i-h3-emlid-neutis-n5h3-devboard allwinner/sun8i-h3-libretech-all-h3-cc allwinner/sun8i-h3-mapleboard-mp130 allwinner/sun8i-h3-nanopi-duo2 allwinner/sun8i-h3-nanopi-m1 allwinner/sun8i-h3-nanopi-m1-plus allwinner/sun8i-h3-nanopi-neo-air allwinner/sun8i-h3-nanopi-neo allwinner/sun8i-h3-nanopi-r1 allwinner/sun8i-h3-orangepi-2 allwinner/sun8i-h3-orangepi-one allwinner/sun8i-h3-orangepi-pc allwinner/sun8i-h3-orangepi-pc-plus allwinner/sun8i-h3-orangepi-plus2e allwinner/sun8i-h3-orangepi-plus allwinner/sun8i-h3-orangepi-zero-plus2 allwinner/sun8i-h3-rervision-dvk allwinner/sun8i-h3-zeropi allwinner/sun8i-h2-plus-orangepi-r1 allwinner/sun8i-h2-plus-orangepi-zero allwinner/sun7i-a20-orangepi allwinner/sun7i-a20-orangepi-mini"
BR2_LINUX_KERNEL_DTB_OVERLAY_SUPPORT=y
BR2_LINUX_KERNEL_NEEDS_HOST_OPENSSL=y
BR2_PACKAGE_BUSYBOX_CONFIG_FRAGMENT_FILES="board/basicengine/common/busybox-extras.config"
BR2_PACKAGE_ALSA_UTILS=y
BR2_PACKAGE_ALSA_UTILS_AMIXER=y
BR2_PACKAGE_LTRACE=y
BR2_PACKAGE_STRACE=y
BR2_PACKAGE_DOSFSTOOLS=y
BR2_PACKAGE_DOSFSTOOLS_FSCK_FAT=y
BR2_PACKAGE_DOSFSTOOLS_MKFS_FAT=y
BR2_PACKAGE_E2FSPROGS=y
BR2_PACKAGE_SSHFS=y
BR2_PACKAGE_FROTZ=y
BR2_PACKAGE_GRAFX2=y
BR2_PACKAGE_MESA3D=y
BR2_PACKAGE_MESA3D_GALLIUM_DRIVER_LIMA=y
BR2_PACKAGE_MESA3D_GALLIUM_DRIVER_SWRAST=y
BR2_PACKAGE_MESA3D_OPENGL_EGL=y
BR2_PACKAGE_MESA3D_OPENGL_ES=y
BR2_PACKAGE_SDL2=y
BR2_PACKAGE_SDL2_KMSDRM=y
BR2_PACKAGE_SDL2_OPENGLES=y
BR2_PACKAGE_SUNXI_DT_OVERLAYS=y
BR2_PACKAGE_DTBOCFG=y
BR2_PACKAGE_KBD=y
BR2_PACKAGE_RTL8189FS=y
BR2_PACKAGE_ENGINEBASIC_SDL=y
BR2_PACKAGE_TINYCC=y
BR2_PACKAGE_LIBDRM_INSTALL_TESTS=y
BR2_PACKAGE_DTC=y
BR2_PACKAGE_DTC_PROGRAMS=y
BR2_PACKAGE_LIBGUDEV=y
BR2_PACKAGE_LIBEVDEV=y
BR2_PACKAGE_DROPBEAR=y
BR2_PACKAGE_DROPBEAR_DISABLE_REVERSEDNS=y
# BR2_PACKAGE_OPENSSH_SERVER is not set
# BR2_PACKAGE_OPENSSH_KEY_UTILS is not set
BR2_PACKAGE_WIRELESS_TOOLS=y
BR2_PACKAGE_WPA_SUPPLICANT=y
BR2_PACKAGE_WPA_SUPPLICANT_CLI=y
BR2_PACKAGE_UTIL_LINUX_FDISKS=y
BR2_PACKAGE_UTIL_LINUX_LIBSMARTCOLS=y
BR2_PACKAGE_ATTO=y
BR2_PACKAGE_JOE=y
# BR2_PACKAGE_JOE_FULL is not set
BR2_PACKAGE_MC=y
BR2_PACKAGE_MG=y
BR2_PACKAGE_NANO=y
BR2_TARGET_ROOTFS_EXT2=y
BR2_TARGET_ROOTFS_EXT2_4=y
BR2_TARGET_ROOTFS_EXT2_SIZE="180M"
# BR2_TARGET_ROOTFS_TAR is not set
BR2_TARGET_UBOOT=y
BR2_TARGET_UBOOT_BUILD_SYSTEM_KCONFIG=y
BR2_TARGET_UBOOT_CUSTOM_VERSION=y
BR2_TARGET_UBOOT_CUSTOM_VERSION_VALUE="2024.01"
BR2_TARGET_UBOOT_BOARD_DEFCONFIG="orangepi_lite"
BR2_TARGET_UBOOT_CONFIG_FRAGMENT_FILES="board/basicengine/common/uboot-extras.config board/basicengine/h3/uboot-extras.config"
BR2_TARGET_UBOOT_NEEDS_DTC=y
BR2_TARGET_UBOOT_NEEDS_PYLIBFDT=y
BR2_TARGET_UBOOT_SPL=y
BR2_TARGET_UBOOT_SPL_NAME="u-boot-sunxi-with-spl.bin"
BR2_PACKAGE_HOST_DOSFSTOOLS=y
BR2_PACKAGE_HOST_GENIMAGE=y
BR2_PACKAGE_HOST_MTOOLS=y
BR2_PACKAGE_HOST_UBOOT_TOOLS=y
BR2_PACKAGE_HOST_UBOOT_TOOLS_BOOT_SCRIPT=y
BR2_PACKAGE_HOST_UBOOT_TOOLS_BOOT_SCRIPT_SOURCE="board/basicengine/h3_lt/boot.cmd"
```

## configs/basicengine_h616_defconfig
```kconfig
BR2_aarch64=y
BR2_ARM_FPU_VFPV4=y
BR2_TOOLCHAIN_BUILDROOT_CXX=y
BR2_CCACHE=y
BR2_GLOBAL_PATCH_DIR="board/basicengine/h616/patches_jh"
BR2_TARGET_GENERIC_HOSTNAME="OrangePi_Zero_2"
BR2_TARGET_GENERIC_ISSUE="Welcome to Buildroot for the Orange Zero 2"
BR2_ROOTFS_DEVICE_CREATION_DYNAMIC_EUDEV=y
BR2_GENERATE_LOCALE="en_US"
BR2_ROOTFS_OVERLAY="board/basicengine/common/rootfs_overlay"
BR2_ROOTFS_POST_IMAGE_SCRIPT="support/scripts/genimage.sh"
BR2_ROOTFS_POST_SCRIPT_ARGS="-c board/basicengine/h616/genimage.cfg"
BR2_LINUX_KERNEL=y
BR2_LINUX_KERNEL_CUSTOM_VERSION=y
BR2_LINUX_KERNEL_CUSTOM_VERSION_VALUE="6.1.55"
BR2_LINUX_KERNEL_USE_CUSTOM_CONFIG=y
BR2_LINUX_KERNEL_CUSTOM_CONFIG_FILE="board/basicengine/h616/arm64_defconfig"
BR2_LINUX_KERNEL_DTS_SUPPORT=y
BR2_LINUX_KERNEL_INTREE_DTS_NAME="allwinner/sun50i-h313-x96q allwinner/sun50i-h313-x96-q-lpddr3 allwinner/sun50i-h616-box-30mv allwinner/sun50i-h616-box-60mv allwinner/sun50i-h616-box allwinner/sun50i-h616-orangepi-zero2 allwinner/sun50i-h616-t95 allwinner/sun50i-h616-tanix-tx6s-axp313 allwinner/sun50i-h616-tanix-tx6s allwinner/sun50i-h616-tx6s allwinner/sun50i-h616-x96-mate allwinner/sun50i-h618-box-30mv allwinner/sun50i-h618-box-60mv allwinner/sun50i-h618-box allwinner/sun50i-h618-lemfo allwinner/sun50i-h618-t95max allwinner/sun50i-h618-vontar-h618"
BR2_LINUX_KERNEL_DTB_OVERLAY_SUPPORT=y
BR2_LINUX_KERNEL_NEEDS_HOST_OPENSSL=y
BR2_PACKAGE_LINUX_TOOLS_GPIO=y
BR2_PACKAGE_BUSYBOX_CONFIG_FRAGMENT_FILES="board/basicengine/common/busybox-extras.config"
BR2_PACKAGE_BUSYBOX_SHOW_OTHERS=y
BR2_PACKAGE_ALSA_UTILS=y
BR2_PACKAGE_ALSA_UTILS_AMIXER=y
BR2_PACKAGE_ALSA_UTILS_APLAY=y
BR2_PACKAGE_FFMPEG=y
BR2_PACKAGE_MJPEGTOOLS=y
BR2_PACKAGE_LZOP=y
BR2_PACKAGE_ZSTD=y
BR2_PACKAGE_GDB=y
BR2_PACKAGE_GDB_DEBUGGER=y
BR2_PACKAGE_LTRACE=y
BR2_PACKAGE_STRACE=y
BR2_PACKAGE_DOSFSTOOLS=y
BR2_PACKAGE_DOSFSTOOLS_FSCK_FAT=y
BR2_PACKAGE_DOSFSTOOLS_MKFS_FAT=y
BR2_PACKAGE_E2FSPROGS=y
BR2_PACKAGE_SSHFS=y
BR2_PACKAGE_FROTZ=y
BR2_PACKAGE_SDL2=y
BR2_PACKAGE_CEDAR=y
BR2_PACKAGE_CEDRUS=y
BR2_PACKAGE_DTBOCFG=y
BR2_PACKAGE_KBD=y
BR2_PACKAGE_RTL8189ES=y
BR2_PACKAGE_RTL8189FS=y
BR2_PACKAGE_RTL8723BU=y
BR2_PACKAGE_RTL8723DS=y
BR2_PACKAGE_RTL8723DS_BT=y
BR2_PACKAGE_USBMOUNT=y
BR2_PACKAGE_ENGINEBASIC=y
BR2_PACKAGE_LUA=y
BR2_PACKAGE_LUA_32BITS=y
BR2_PACKAGE_LIBDRM=y
BR2_PACKAGE_LIBDRM_INSTALL_TESTS=y
BR2_PACKAGE_DTC=y
BR2_PACKAGE_DTC_PROGRAMS=y
BR2_PACKAGE_LIBGPIOD=y
BR2_PACKAGE_LIBGPIOD_TOOLS=y
BR2_PACKAGE_LIBGUDEV=y
BR2_PACKAGE_LIBINPUT=y
BR2_PACKAGE_EXPAT=y
BR2_PACKAGE_NCURSES_ADDITIONAL_TERMINFO="a/ansiw c/cons25-debian"
BR2_PACKAGE_SLANG=y
BR2_PACKAGE_DROPBEAR=y
BR2_PACKAGE_DROPBEAR_DISABLE_REVERSEDNS=y
BR2_PACKAGE_NETCAT=y
BR2_PACKAGE_NETCAT_OPENBSD=y
# BR2_PACKAGE_OPENSSH_SERVER is not set
# BR2_PACKAGE_OPENSSH_KEY_UTILS is not set
BR2_PACKAGE_WIRELESS_TOOLS=y
BR2_PACKAGE_WPA_SUPPLICANT=y
BR2_PACKAGE_WPA_SUPPLICANT_WEXT=y
BR2_PACKAGE_WPA_SUPPLICANT_CLI=y
BR2_PACKAGE_WPA_SUPPLICANT_PASSPHRASE=y
BR2_PACKAGE_JAILHOUSE=y
BR2_PACKAGE_ATTO=y
BR2_PACKAGE_JOE=y
BR2_PACKAGE_LESS=y
BR2_PACKAGE_MC=y
BR2_PACKAGE_MG=y
BR2_PACKAGE_NANO=y
BR2_PACKAGE_UEMACS=y
BR2_PACKAGE_VIM=y
# BR2_PACKAGE_VIM_RUNTIME is not set
BR2_TARGET_ROOTFS_EXT2=y
BR2_TARGET_ROOTFS_EXT2_4=y
BR2_TARGET_ROOTFS_EXT2_SIZE="180M"
# BR2_TARGET_ROOTFS_TAR is not set
BR2_TARGET_ARM_TRUSTED_FIRMWARE=y
BR2_TARGET_ARM_TRUSTED_FIRMWARE_CUSTOM_VERSION=y
BR2_TARGET_ARM_TRUSTED_FIRMWARE_CUSTOM_VERSION_VALUE="v2.8"
BR2_TARGET_ARM_TRUSTED_FIRMWARE_PLATFORM="sun50i_h616"
BR2_TARGET_ARM_TRUSTED_FIRMWARE_DEBUG=y
BR2_TARGET_UBOOT=y
BR2_TARGET_UBOOT_BUILD_SYSTEM_KCONFIG=y
BR2_TARGET_UBOOT_CUSTOM_VERSION=y
BR2_TARGET_UBOOT_CUSTOM_VERSION_VALUE="2021.07"
BR2_TARGET_UBOOT_BOARD_DEFCONFIG="x96_q_lpddr3"
BR2_TARGET_UBOOT_CONFIG_FRAGMENT_FILES="board/basicengine/common/uboot-extras.config"
BR2_TARGET_UBOOT_NEEDS_DTC=y
BR2_TARGET_UBOOT_NEEDS_PYLIBFDT=y
BR2_TARGET_UBOOT_NEEDS_ATF_BL31=y
BR2_TARGET_UBOOT_SPL=y
BR2_TARGET_UBOOT_SPL_NAME="u-boot-sunxi-with-spl.bin"
BR2_PACKAGE_ALLWINNER_BARE_METAL_PLATFORM="h616"
BR2_PACKAGE_HOST_DOSFSTOOLS=y
BR2_PACKAGE_HOST_GENIMAGE=y
BR2_PACKAGE_HOST_MTOOLS=y
BR2_PACKAGE_HOST_UBOOT_TOOLS=y
BR2_PACKAGE_HOST_UBOOT_TOOLS_BOOT_SCRIPT=y
BR2_PACKAGE_HOST_UBOOT_TOOLS_BOOT_SCRIPT_SOURCE="board/basicengine/h616/boot.cmd"
```
