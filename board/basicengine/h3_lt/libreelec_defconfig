## configs/basicengine_h616_lt_defconfig
```kconfig
BR2_aarch64=y
BR2_ARM_FPU_VFPV4=y
BR2_TOOLCHAIN_BUILDROOT_CXX=y
BR2_CCACHE=y
BR2_GLOBAL_PATCH_DIR="board/basicengine/h616_lt/patches"
BR2_TARGET_GENERIC_HOSTNAME="basicengine"
BR2_TARGET_GENERIC_ISSUE="Welcome to Buildroot for the BASIC Engine H616"
BR2_ROOTFS_DEVICE_CREATION_DYNAMIC_EUDEV=y
BR2_ROOTFS_OVERLAY="board/basicengine/common/rootfs_overlay board/basicengine/lt/rootfs_overlay"
BR2_ROOTFS_POST_IMAGE_SCRIPT="support/scripts/genimage.sh"
BR2_ROOTFS_POST_SCRIPT_ARGS="-c board/basicengine/h616_lt/genimage.cfg"
BR2_LINUX_KERNEL=y
BR2_LINUX_KERNEL_CUSTOM_VERSION=y
BR2_LINUX_KERNEL_CUSTOM_VERSION_VALUE="6.1.55"
BR2_LINUX_KERNEL_USE_CUSTOM_CONFIG=y
BR2_LINUX_KERNEL_CUSTOM_CONFIG_FILE="board/basicengine/h616_lt/arm64_defconfig"
BR2_LINUX_KERNEL_DTS_SUPPORT=y
BR2_LINUX_KERNEL_INTREE_DTS_NAME="allwinner/sun50i-h313-x96q allwinner/sun50i-h313-x96-q-lpddr3 allwinner/sun50i-h616-box-30mv allwinner/sun50i-h616-box-60mv allwinner/sun50i-h616-box allwinner/sun50i-h616-orangepi-zero2 allwinner/sun50i-h616-t95 allwinner/sun50i-h616-tanix-tx6s-axp313 allwinner/sun50i-h616-tanix-tx6s allwinner/sun50i-h616-tx6s allwinner/sun50i-h616-x96-mate allwinner/sun50i-h618-box-30mv allwinner/sun50i-h618-box-60mv allwinner/sun50i-h618-box allwinner/sun50i-h618-lemfo allwinner/sun50i-h618-t95max allwinner/sun50i-h618-vontar-h618"
BR2_LINUX_KERNEL_DTB_OVERLAY_SUPPORT=y
BR2_LINUX_KERNEL_NEEDS_HOST_OPENSSL=y
BR2_PACKAGE_BUSYBOX_CONFIG_FRAGMENT_FILES="board/basicengine/common/busybox-extras.config"
BR2_PACKAGE_ALSA_UTILS=y
BR2_PACKAGE_ALSA_UTILS_AMIXER=y
BR2_PACKAGE_LTRACE=y
BR2_PACKAGE_STRACE=y
BR2_PACKAGE_DOSFSTOOLS=y
BR2_PACKAGE_DOSFSTOOLS_FSCK_FAT=y
BR2_PACKAGE_DOSFSTOOLS_MKFS_FAT=y
BR2_PACKAGE_E2FSPROGS=y
BR2_PACKAGE_SSHFS=y
BR2_PACKAGE_FROTZ=y
BR2_PACKAGE_GRAFX2=y
BR2_PACKAGE_MESA3D=y
BR2_PACKAGE_MESA3D_GALLIUM_DRIVER_PANFROST=y
BR2_PACKAGE_MESA3D_GALLIUM_DRIVER_SWRAST=y
BR2_PACKAGE_MESA3D_OPENGL_EGL=y
BR2_PACKAGE_MESA3D_OPENGL_ES=y
BR2_PACKAGE_SDL2=y
BR2_PACKAGE_SDL2_KMSDRM=y
BR2_PACKAGE_SDL2_OPENGLES=y
BR2_PACKAGE_DTBOCFG=y
BR2_PACKAGE_KBD=y
BR2_PACKAGE_RTL8189FS=y
BR2_PACKAGE_ENGINEBASIC_SDL=y
BR2_PACKAGE_LIBDRM_INSTALL_TESTS=y
BR2_PACKAGE_DTC=y
BR2_PACKAGE_DTC_PROGRAMS=y
BR2_PACKAGE_LIBGUDEV=y
BR2_PACKAGE_LIBEVDEV=y
BR2_PACKAGE_DROPBEAR=y
BR2_PACKAGE_DROPBEAR_DISABLE_REVERSEDNS=y
# BR2_PACKAGE_OPENSSH_SERVER is not set
# BR2_PACKAGE_OPENSSH_KEY_UTILS is not set
BR2_PACKAGE_WIRELESS_TOOLS=y
BR2_PACKAGE_WPA_SUPPLICANT=y
BR2_PACKAGE_WPA_SUPPLICANT_CLI=y
BR2_PACKAGE_UTIL_LINUX_FDISKS=y
BR2_PACKAGE_UTIL_LINUX_LIBSMARTCOLS=y
BR2_PACKAGE_ATTO=y
BR2_PACKAGE_JOE=y
# BR2_PACKAGE_JOE_FULL is not set
BR2_PACKAGE_MC=y
BR2_PACKAGE_MG=y
BR2_PACKAGE_NANO=y
BR2_TARGET_ROOTFS_EXT2=y
BR2_TARGET_ROOTFS_EXT2_4=y
BR2_TARGET_ROOTFS_EXT2_SIZE="180M"
# BR2_TARGET_ROOTFS_TAR is not set
BR2_TARGET_ARM_TRUSTED_FIRMWARE=y
BR2_TARGET_ARM_TRUSTED_FIRMWARE_CUSTOM_VERSION=y
BR2_TARGET_ARM_TRUSTED_FIRMWARE_CUSTOM_VERSION_VALUE="v2.8"
BR2_TARGET_ARM_TRUSTED_FIRMWARE_PLATFORM="sun50i_h616"
BR2_TARGET_ARM_TRUSTED_FIRMWARE_DEBUG=y
BR2_TARGET_UBOOT=y
BR2_TARGET_UBOOT_BUILD_SYSTEM_KCONFIG=y
BR2_TARGET_UBOOT_CUSTOM_VERSION=y
BR2_TARGET_UBOOT_CUSTOM_VERSION_VALUE="2021.07"
BR2_TARGET_UBOOT_BOARD_DEFCONFIG="x96_q_lpddr3"
BR2_TARGET_UBOOT_CONFIG_FRAGMENT_FILES="board/basicengine/common/uboot-extras.config"
BR2_TARGET_UBOOT_NEEDS_DTC=y
BR2_TARGET_UBOOT_NEEDS_PYLIBFDT=y
BR2_TARGET_UBOOT_NEEDS_ATF_BL31=y
BR2_TARGET_UBOOT_SPL=y
BR2_TARGET_UBOOT_SPL_NAME="u-boot-sunxi-with-spl.bin"
BR2_PACKAGE_HOST_DOSFSTOOLS=y
BR2_PACKAGE_HOST_GENIMAGE=y
BR2_PACKAGE_HOST_MTOOLS=y
BR2_PACKAGE_HOST_UBOOT_TOOLS=y
BR2_PACKAGE_HOST_UBOOT_TOOLS_BOOT_SCRIPT=y
BR2_PACKAGE_HOST_UBOOT_TOOLS_BOOT_SCRIPT_SOURCE="board/basicengine/h616_lt/boot.cmd"
```

## configs/basicengine_pc_lt_defconfig
```kconfig
BR2_x86_64=y
BR2_CCACHE=y
BR2_TOOLCHAIN_BUILDROOT_LOCALE=y
BR2_TOOLCHAIN_BUILDROOT_CXX=y
BR2_ROOTFS_DEVICE_CREATION_DYNAMIC_EUDEV=y
BR2_TARGET_GENERIC_GETTY_PORT="tty1"
BR2_ROOTFS_OVERLAY="board/basicengine/common/rootfs_overlay board/basicengine/lt/rootfs_overlay"
BR2_ROOTFS_POST_BUILD_SCRIPT="board/basicengine/pc_lt/post-build.sh"
BR2_ROOTFS_POST_IMAGE_SCRIPT="support/scripts/genimage.sh"
BR2_ROOTFS_POST_SCRIPT_ARGS="-c board/basicengine/pc_lt/genimage-bios.cfg"
BR2_LINUX_KERNEL=y
BR2_LINUX_KERNEL_USE_CUSTOM_CONFIG=y
BR2_LINUX_KERNEL_CUSTOM_CONFIG_FILE="board/basicengine/pc_lt/linux.config"
BR2_LINUX_KERNEL_INSTALL_TARGET=y
BR2_LINUX_KERNEL_NEEDS_HOST_OPENSSL=y
BR2_PACKAGE_BUSYBOX_CONFIG_FRAGMENT_FILES="board/basicengine/common/busybox-extras.config"
BR2_PACKAGE_ALSA_UTILS=y
BR2_PACKAGE_ALSA_UTILS_AMIXER=y
BR2_PACKAGE_LTRACE=y
BR2_PACKAGE_STRACE=y
BR2_PACKAGE_DOSFSTOOLS=y
BR2_PACKAGE_DOSFSTOOLS_FSCK_FAT=y
BR2_PACKAGE_DOSFSTOOLS_MKFS_FAT=y
BR2_PACKAGE_E2FSPROGS=y
BR2_PACKAGE_SSHFS=y
BR2_PACKAGE_FROTZ=y
BR2_PACKAGE_GRAFX2=y
BR2_PACKAGE_MESA3D=y
BR2_PACKAGE_MESA3D_GALLIUM_DRIVER_CROCUS=y
BR2_PACKAGE_MESA3D_GALLIUM_DRIVER_I915=y
BR2_PACKAGE_MESA3D_GALLIUM_DRIVER_IRIS=y
BR2_PACKAGE_MESA3D_GALLIUM_DRIVER_NOUVEAU=y
BR2_PACKAGE_MESA3D_GALLIUM_DRIVER_R300=y
BR2_PACKAGE_MESA3D_GALLIUM_DRIVER_R600=y
BR2_PACKAGE_MESA3D_GALLIUM_DRIVER_SVGA=y
BR2_PACKAGE_MESA3D_DRI_DRIVER_I965=y
BR2_PACKAGE_MESA3D_DRI_DRIVER_NOUVEAU=y
BR2_PACKAGE_MESA3D_DRI_DRIVER_RADEON=y
BR2_PACKAGE_MESA3D_OPENGL_EGL=y
BR2_PACKAGE_MESA3D_OPENGL_ES=y
BR2_PACKAGE_SDL2=y
BR2_PACKAGE_SDL2_KMSDRM=y
BR2_PACKAGE_SDL2_OPENGLES=y
BR2_PACKAGE_LINUX_FIRMWARE=y
BR2_PACKAGE_LINUX_FIRMWARE_INTEL_SST_DSP=y
BR2_PACKAGE_LINUX_FIRMWARE_AMDGPU=y
BR2_PACKAGE_LINUX_FIRMWARE_I915=y
BR2_PACKAGE_LINUX_FIRMWARE_RADEON=y
BR2_PACKAGE_LINUX_FIRMWARE_ATHEROS_9170=y
BR2_PACKAGE_LINUX_FIRMWARE_ATHEROS_9271=y
BR2_PACKAGE_LINUX_FIRMWARE_IWLWIFI_3160=y
BR2_PACKAGE_LINUX_FIRMWARE_IWLWIFI_3168=y
BR2_PACKAGE_LINUX_FIRMWARE_IWLWIFI_5000=y
BR2_PACKAGE_LINUX_FIRMWARE_IWLWIFI_6000G2A=y
BR2_PACKAGE_LINUX_FIRMWARE_IWLWIFI_6000G2B=y
BR2_PACKAGE_LINUX_FIRMWARE_IWLWIFI_7260=y
BR2_PACKAGE_LINUX_FIRMWARE_IWLWIFI_7265D=y
BR2_PACKAGE_LINUX_FIRMWARE_IWLWIFI_8000C=y
BR2_PACKAGE_LINUX_FIRMWARE_IWLWIFI_8265=y
BR2_PACKAGE_LINUX_FIRMWARE_RALINK_RT73=y
BR2_PACKAGE_LINUX_FIRMWARE_RALINK_RT2XX=y
BR2_PACKAGE_LINUX_FIRMWARE_RTL_81XX=y
BR2_PACKAGE_LINUX_FIRMWARE_RTL_87XX=y
BR2_PACKAGE_LINUX_FIRMWARE_RTL_88XX=y
BR2_PACKAGE_LINUX_FIRMWARE_RTL_8169=y
BR2_PACKAGE_ACPID=y
BR2_PACKAGE_ENGINEBASIC_SDL=y
BR2_PACKAGE_LUA=y
BR2_PACKAGE_TINYCC=y
BR2_PACKAGE_LIBGUDEV=y
BR2_PACKAGE_LIBEVDEV=y
BR2_PACKAGE_CONNMAN=y
BR2_PACKAGE_CONNMAN_WIFI=y
BR2_PACKAGE_CONNMAN_CLIENT=y
BR2_PACKAGE_DROPBEAR=y
BR2_PACKAGE_DROPBEAR_DISABLE_REVERSEDNS=y
# BR2_PACKAGE_OPENSSH_SERVER is not set
# BR2_PACKAGE_OPENSSH_KEY_UTILS is not set
BR2_PACKAGE_WIRELESS_TOOLS=y
BR2_PACKAGE_WPA_SUPPLICANT_CLI=y
BR2_PACKAGE_ATTO=y
BR2_PACKAGE_JOE=y
# BR2_PACKAGE_JOE_FULL is not set
BR2_PACKAGE_MC=y
BR2_PACKAGE_MG=y
BR2_PACKAGE_NANO=y
BR2_TARGET_ROOTFS_EXT2=y
BR2_TARGET_ROOTFS_EXT2_4=y
BR2_TARGET_ROOTFS_EXT2_SIZE="600M"
BR2_TARGET_ROOTFS_EXT2_RESBLKS=0
# BR2_TARGET_ROOTFS_TAR is not set
BR2_TARGET_GRUB2=y
BR2_TARGET_GRUB2_INSTALL_TOOLS=y
BR2_PACKAGE_HOST_GENIMAGE=y
```

## configs/basicengine_rpi4_lt_defconfig
```kconfig
BR2_arm=y
BR2_cortex_a72=y
BR2_ARM_FPU_NEON_VFPV4=y
BR2_CCACHE=y
BR2_GLOBAL_PATCH_DIR="board/basicengine/rpi4_lt/patches"
BR2_TOOLCHAIN_BUILDROOT_LOCALE=y
BR2_TOOLCHAIN_BUILDROOT_CXX=y
BR2_ROOTFS_DEVICE_CREATION_DYNAMIC_EUDEV=y
BR2_ROOTFS_OVERLAY="board/basicengine/common/rootfs_overlay board/basicengine/lt/rootfs_overlay"
BR2_SYSTEM_DHCP="eth0"
BR2_ROOTFS_POST_BUILD_SCRIPT="board/basicengine/rpi4_lt/post-build.sh"
BR2_ROOTFS_POST_IMAGE_SCRIPT="board/basicengine/rpi4_lt/post-image.sh"
BR2_LINUX_KERNEL=y
BR2_LINUX_KERNEL_CUSTOM_TARBALL=y
BR2_LINUX_KERNEL_CUSTOM_TARBALL_LOCATION="$(call github,raspberrypi,linux,a6e17f7a4b72a4b2911d1d36bde258d5ba56d3a3)/linux-a6e17f7a4b72a4b2911d1d36bde258d5ba56d3a3.tar.gz"
BR2_LINUX_KERNEL_DEFCONFIG="bcm2711"
BR2_LINUX_KERNEL_CONFIG_FRAGMENT_FILES="board/basicengine/rpi4/linux-extras.config"
BR2_LINUX_KERNEL_DTS_SUPPORT=y
BR2_LINUX_KERNEL_INTREE_DTS_NAME="bcm2711-rpi-4-b"
BR2_LINUX_KERNEL_NEEDS_HOST_OPENSSL=y
BR2_PACKAGE_BUSYBOX_CONFIG_FRAGMENT_FILES="board/basicengine/common/busybox-extras.config"
BR2_PACKAGE_ALSA_UTILS=y
BR2_PACKAGE_ALSA_UTILS_AMIXER=y
BR2_PACKAGE_LTRACE=y
BR2_PACKAGE_STRACE=y
BR2_PACKAGE_DOSFSTOOLS=y
BR2_PACKAGE_DOSFSTOOLS_FSCK_FAT=y
BR2_PACKAGE_DOSFSTOOLS_MKFS_FAT=y
BR2_PACKAGE_E2FSPROGS=y
BR2_PACKAGE_SSHFS=y
BR2_PACKAGE_FROTZ=y
BR2_PACKAGE_GRAFX2=y
BR2_PACKAGE_MESA3D=y
BR2_PACKAGE_MESA3D_GALLIUM_DRIVER_SWRAST=y
BR2_PACKAGE_MESA3D_GALLIUM_DRIVER_V3D=y
BR2_PACKAGE_MESA3D_GALLIUM_DRIVER_VC4=y
BR2_PACKAGE_MESA3D_OPENGL_ES=y
BR2_PACKAGE_SDL2=y
BR2_PACKAGE_SDL2_KMSDRM=y
BR2_PACKAGE_SDL2_OPENGLES=y
BR2_PACKAGE_RPI_FIRMWARE=y
BR2_PACKAGE_RPI_FIRMWARE_VARIANT_PI4=y
BR2_PACKAGE_RPI_FIRMWARE_CONFIG_FILE="board/basicengine/rpi4_lt/config_4.txt"
BR2_PACKAGE_DTBOCFG=y
BR2_PACKAGE_KBD=y
BR2_PACKAGE_RTL8189FS=y
BR2_PACKAGE_ENGINEBASIC_SDL=y
BR2_PACKAGE_LUA=y
BR2_PACKAGE_TINYCC=y
BR2_PACKAGE_LIBDRM_INSTALL_TESTS=y
BR2_PACKAGE_DTC=y
BR2_PACKAGE_DTC_PROGRAMS=y
BR2_PACKAGE_LIBGUDEV=y
BR2_PACKAGE_LIBEVDEV=y
BR2_PACKAGE_NCURSES_WCHAR=y
BR2_PACKAGE_DROPBEAR=y
BR2_PACKAGE_DROPBEAR_DISABLE_REVERSEDNS=y
# BR2_PACKAGE_OPENSSH_SERVER is not set
# BR2_PACKAGE_OPENSSH_KEY_UTILS is not set
BR2_PACKAGE_WIRELESS_TOOLS=y
BR2_PACKAGE_WPA_SUPPLICANT=y
BR2_PACKAGE_WPA_SUPPLICANT_CLI=y
BR2_PACKAGE_ATTO=y
BR2_PACKAGE_JOE=y
# BR2_PACKAGE_JOE_FULL is not set
BR2_PACKAGE_MC=y
BR2_PACKAGE_MG=y
BR2_PACKAGE_NANO=y
BR2_TARGET_ROOTFS_EXT2=y
BR2_TARGET_ROOTFS_EXT2_4=y
BR2_TARGET_ROOTFS_EXT2_SIZE="150M"
# BR2_TARGET_ROOTFS_TAR is not set
BR2_PACKAGE_HOST_DOSFSTOOLS=y
BR2_PACKAGE_HOST_GENIMAGE=y
BR2_PACKAGE_HOST_MTOOLS=y
```

## configs/orangepi_lite_defconfig
```kconfig
BR2_arm=y
BR2_cortex_a7=y
BR2_ARM_FPU_VFPV4=y
BR2_GLOBAL_PATCH_DIR="board/orangepi/orangepi-lite/patches"
BR2_PACKAGE_HOST_LINUX_HEADERS_CUSTOM_5_15=y
BR2_TARGET_GENERIC_HOSTNAME="OrangePi_Lite"
BR2_TARGET_GENERIC_ISSUE="Welcome to Buildroot for the Orange Pi Lite"
BR2_LINUX_KERNEL=y
BR2_LINUX_KERNEL_CUSTOM_VERSION=y
BR2_LINUX_KERNEL_CUSTOM_VERSION_VALUE="5.15.1"
BR2_LINUX_KERNEL_DEFCONFIG="sunxi"
BR2_LINUX_KERNEL_CONFIG_FRAGMENT_FILES="board/orangepi/orangepi-lite/linux-extras.config"
BR2_LINUX_KERNEL_DTS_SUPPORT=y
BR2_LINUX_KERNEL_INTREE_DTS_NAME="sun8i-h3-orangepi-lite sun8i-h3-bananapi-m2-plus sun8i-h3-bananapi-m2-plus-v1.2 sun8i-h3-beelink-x2 sun8i-h3-emlid-neutis-n5h3-devboard sun8i-h3-libretech-all-h3-cc sun8i-h3-mapleboard-mp130 sun8i-h3-nanopi-duo2 sun8i-h3-nanopi-m1 sun8i-h3-nanopi-m1-plus sun8i-h3-nanopi-neo-air sun8i-h3-nanopi-neo sun8i-h3-nanopi-r1 sun8i-h3-orangepi-2 sun8i-h3-orangepi-one sun8i-h3-orangepi-pc sun8i-h3-orangepi-pc-plus sun8i-h3-orangepi-plus2e sun8i-h3-orangepi-plus sun8i-h3-orangepi-zero-plus2 sun8i-h3-rervision-dvk sun8i-h3-zeropi"
BR2_LINUX_KERNEL_NEEDS_HOST_OPENSSL=y
BR2_PACKAGE_RTL8189FS=y
BR2_PACKAGE_WIRELESS_TOOLS=y
BR2_PACKAGE_WPA_SUPPLICANT=y
BR2_PACKAGE_WPA_SUPPLICANT_CLI=y
BR2_TARGET_ROOTFS_EXT2=y
BR2_TARGET_ROOTFS_EXT2_4=y
# BR2_TARGET_ROOTFS_TAR is not set
BR2_TARGET_UBOOT=y
BR2_TARGET_UBOOT_BUILD_SYSTEM_KCONFIG=y
BR2_TARGET_UBOOT_CUSTOM_VERSION=y
BR2_TARGET_UBOOT_CUSTOM_VERSION_VALUE="2021.10"
BR2_TARGET_UBOOT_BOARD_DEFCONFIG="orangepi_lite"
BR2_TARGET_UBOOT_NEEDS_DTC=y
BR2_TARGET_UBOOT_NEEDS_PYTHON3=y
BR2_TARGET_UBOOT_NEEDS_PYLIBFDT=y
BR2_TARGET_UBOOT_SPL=y
BR2_TARGET_UBOOT_SPL_NAME="u-boot-sunxi-with-spl.bin"
BR2_PACKAGE_HOST_UBOOT_TOOLS=y
BR2_PACKAGE_HOST_UBOOT_TOOLS_BOOT_SCRIPT=y
BR2_PACKAGE_HOST_UBOOT_TOOLS_BOOT_SCRIPT_SOURCE="board/orangepi/orangepi-lite/boot.cmd"
BR2_PACKAGE_HOST_DOSFSTOOLS=y
BR2_PACKAGE_HOST_GENIMAGE=y
BR2_PACKAGE_HOST_MTOOLS=y
BR2_ROOTFS_POST_IMAGE_SCRIPT="support/scripts/genimage.sh"
BR2_ROOTFS_POST_SCRIPT_ARGS="-c board/orangepi/orangepi-lite/genimage.cfg"
```

## package/allwinner-bare-metal/Config.in.host
```kconfig
config BR2_PACKAGE_ALLWINNER_BARE_METAL_PLATFORM
	string "allwinner-bare-metal platform"
	default "h3"
```

## package/atto/Config.in
```kconfig
config BR2_PACKAGE_ATTO
	bool "atto"
	depends on BR2_PACKAGE_NCURSES_WCHAR
	help
	  The smallest functional Emacs in less than 2000 lines of C.
```

## package/enginebasic-sdl/Config.in
```kconfig
config BR2_PACKAGE_ENGINEBASIC_SDL
        bool "enginebasic"
	select BR2_PACKAGE_LIBGPIOD
        help
          This is a comment that explains what enginebasic is. The help text
          should be wrapped.
```

## package/enginebasic/Config.in
```kconfig
config BR2_PACKAGE_ENGINEBASIC
        bool "enginebasic"
        help
	  Engine BASIC for Jailhouse
```

## package/grafx2/Config.in
```kconfig
config BR2_PACKAGE_GRAFX2
        bool "grafx2"
	select BR2_PACKAGE_LIBPNG
	select BR2_PACKAGE_SDL2_IMAGE
	select BR2_PACKAGE_TIFF
	select BR2_PACKAGE_LUA
        help
          GrafX2 - The Ultimate 256-color bitmap paint program
```

## package/python-polib/Config.in.host
```kconfig
config BR2_PACKAGE_HOST_PYTHON_POLIB
	bool "host python-polib"
	help
	  A library to manipulate gettext files (po and mo files).

	  https://pypi.python.org/pypi/polib
```

## package/rtl8723as/Config.in
```kconfig
config BR2_PACKAGE_RTL8723AS
	bool "rtl8723as"
	depends on !BR2_s390x
	depends on BR2_LINUX_KERNEL
	help
	  Wireless driver rtl8723as.

comment "rtl8723as needs a Linux kernel to be built"
	depends on !BR2_s390x
	depends on !BR2_LINUX_KERNEL
```

## package/sunxi-dt-overlays/Config.in
```kconfig
config BR2_PACKAGE_SUNXI_DT_OVERLAYS
	bool "sunxi-dt-overlays"
	depends on BR2_arm || BR2_aarch64
	help
		sunxi DT overlays
```
